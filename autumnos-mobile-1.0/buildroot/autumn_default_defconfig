## autumnos-mobile-1.0/buildroot/autumn_default_defconfig
```kconfig
BR2_riscv=y
BR2_riscv_custom=y
BR2_RISCV_ISA_RVM=y
BR2_RISCV_ISA_RVA=y
BR2_RISCV_ISA_RVF=y
BR2_RISCV_ISA_RVD=y
BR2_RISCV_ISA_RVC=y
BR2_KERNEL_HEADERS_6_19=y
BR2_BINUTILS_VERSION_2_44_X=y
BR2_BINUTILS_GPROFNG=y
BR2_PACKAGE_AUTUMN_SDK=y
BR2_TOOLCHAIN_BUILDROOT_CXX=y
BR2_FORTIFY_SOURCE_2=y
BR2_ROOTFS_DEVICE_CREATION_DYNAMIC_MDEV=y
BR2_TARGET_GENERIC_ROOT_PASSWD="Press_Your_Root_Access_Password"
BR2_TARGET_GENERIC_GETTY_PORT="ttyS0"
BR2_TARGET_TZ_INFO=y
BR2_TARGET_LOCALTIME="Europe/Istanbul"
BR2_ROOTFS_USERS_TABLES="board/autix/generic/rootfs_overlay/etc/users.txt"
BR2_ROOTFS_OVERLAY="board/autix/generic/rootfs_overlay"
BR2_ROOTFS_POST_IMAGE_SCRIPT="support/scripts/genimage.sh"
BR2_ROOTFS_POST_SCRIPT_ARGS="-c board/autix/generic/genimage.cfg"
BR2_LINUX_KERNEL=y
BR2_LINUX_KERNEL_USE_CUSTOM_CONFIG=y
BR2_LINUX_KERNEL_CUSTOM_CONFIG_FILE="$(TOPDIR)/buildroot/configs/autumn_kernel_defconfig"
BR2_LINUX_KERNEL_DTS_SUPPORT=y
BR2_LINUX_KERNEL_INTREE_DTS_NAME="allwinner/sun20i-d1s-autumn-default"
BR2_PACKAGE_BUSYBOX_SHOW_OTHERS=y
BR2_PACKAGE_ALSA_UTILS=y
BR2_PACKAGE_FFMPEG=y
BR2_PACKAGE_FFMPEG_FFPLAY=y
BR2_PACKAGE_GSTREAMER1=y
BR2_PACKAGE_GST1_PLUGINS_BASE_PLUGIN_APP=y
BR2_PACKAGE_GST1_PLUGINS_BASE_PLUGIN_VIDEOTESTSRC=y
BR2_PACKAGE_GST1_PLUGINS_GOOD=y
BR2_PACKAGE_GST1_PLUGINS_GOOD_JPEG=y
BR2_PACKAGE_GST1_PLUGINS_GOOD_PLUGIN_V4L2=y
BR2_PACKAGE_MPG123=y
BR2_PACKAGE_LIBTOOL=y
BR2_PACKAGE_DEJAVU=y
BR2_PACKAGE_CHOCOLATE_DOOM=y
BR2_PACKAGE_DOOM_WAD=y
BR2_PACKAGE_LTRIS=y
BR2_PACKAGE_LVGL=y
BR2_PACKAGE_LV_DRIVERS=y
BR2_PACKAGE_FB_TEST_APP=y
BR2_PACKAGE_FBGRAB=y
BR2_PACKAGE_FBV=y
BR2_PACKAGE_SDL_IMAGE=y
BR2_PACKAGE_SDL_IMAGE_JPEG=y
BR2_PACKAGE_SDL_IMAGE_PNG=y
BR2_PACKAGE_GPM=y
BR2_PACKAGE_RTL8723DS_BT=y
BR2_PACKAGE_LUA=y
BR2_PACKAGE_LUA_CJSON=y
BR2_PACKAGE_LUASOCKET=y
BR2_PACKAGE_PYTHON3=y
BR2_PACKAGE_PYTHON_KIVY=y
BR2_PACKAGE_PYTHON_PIP=y
BR2_PACKAGE_BCG729=y
BR2_PACKAGE_LIBSNDFILE=y
BR2_PACKAGE_SPEEX=y
BR2_PACKAGE_CA_CERTIFICATES=y
BR2_PACKAGE_LIBOPENSSL_BIN=y
BR2_PACKAGE_FONTCONFIG=y
BR2_PACKAGE_HARFBUZZ=y
BR2_PACKAGE_LIBDRM=y
BR2_PACKAGE_QT6=y
BR2_PACKAGE_QT6BASE=y
BR2_PACKAGE_STRACE=y
BR2_PACKAGE_LIBDRM_INSTALL_TESTS=y
BR2_PACKAGE_LIBDISPLAY_INFO=y
BR2_PACKAGE_LIBV4L=y
BR2_PACKAGE_LIBV4L_UTILS=y
BR2_PACKAGE_LIBPLACEBO=y
BR2_PACKAGE_LIBCURL=y
BR2_PACKAGE_LIBEXOSIP2=y
BR2_PACKAGE_LIBEVDEV=y
BR2_PACKAGE_LIBFRIBIDI=y
BR2_PACKAGE_PCRE2_16=y
BR2_PACKAGE_BLUEZ5_UTILS=y
BR2_PACKAGE_BLUEZ5_UTILS_CLIENT=y
BR2_PACKAGE_BLUEZ5_UTILS_PLUGINS_AUDIO=y
BR2_PACKAGE_DHCPCD=y
BR2_PACKAGE_DROPBEAR=y
BR2_PACKAGE_IPROUTE2=y
BR2_PACKAGE_LINKS=y
BR2_PACKAGE_LINKS_GRAPHICS=y
BR2_PACKAGE_NTP=y
BR2_PACKAGE_WGET=y
BR2_PACKAGE_WPA_SUPPLICANT=y
BR2_PACKAGE_WPA_SUPPLICANT_AUTOSCAN=y
BR2_PACKAGE_SUDO=y
BR2_PACKAGE_KMOD=y
BR2_PACKAGE_KMOD_TOOLS=y
BR2_PACKAGE_NANO=y
BR2_TARGET_ROOTFS_CPIO=y
BR2_TARGET_ROOTFS_CPIO_GZIP=y
BR2_TARGET_ROOTFS_EXT2=y
BR2_TARGET_ROOTFS_EXT2_4=y
BR2_TARGET_ROOTFS_EXT2_SIZE="1024M"
# BR2_TARGET_ROOTFS_TAR is not set
BR2_TARGET_OPENSBI=y
BR2_TARGET_OPENSBI_CUSTOM_VERSION=y
BR2_TARGET_OPENSBI_CUSTOM_VERSION_VALUE="1.2"
BR2_TARGET_OPENSBI_PLAT="generic"
# BR2_TARGET_OPENSBI_INSTALL_JUMP_IMG is not set
BR2_TARGET_UBOOT=y
BR2_TARGET_UBOOT_BUILD_SYSTEM_KCONFIG=y
BR2_TARGET_UBOOT_CUSTOM_TARBALL=y
BR2_TARGET_UBOOT_CUSTOM_TARBALL_LOCATION="$(call github,smaeul,u-boot,528ae9bc6c55edd3ffe642734b4132a8246ea777)/uboot-528ae9bc6c55edd3ffe642734b4132a8246ea777.tar.gz"
BR2_TARGET_UBOOT_BOARD_DEFCONFIG="lichee_rv_dock"
BR2_TARGET_UBOOT_NEEDS_DTC=y
BR2_TARGET_UBOOT_NEEDS_PYLIBFDT=y
BR2_TARGET_UBOOT_NEEDS_OPENSSL=y
BR2_TARGET_UBOOT_NEEDS_OPENSBI=y
# BR2_TARGET_UBOOT_FORMAT_BIN is not set
BR2_TARGET_UBOOT_FORMAT_CUSTOM=y
BR2_TARGET_UBOOT_FORMAT_CUSTOM_NAME="u-boot-sunxi-with-spl.bin"
BR2_PACKAGE_HOST_GENIMAGE=y
BR2_PACKAGE_HOST_PYTHON_CYTHON=y
```

## autumnos-mobile-1.0/buildroot/autumnsdk/Config.in
```kconfig
menuconfig BR2_PACKAGE_AUTUMN_SDK
	bool "AutumnOS SDK"
	depends on BR2_PACKAGE_LUA
	depends on BR2_PACKAGE_PYTHON3
	help
	   AutumnOS SDK/Platform development tools.


if BR2_PACKAGE_AUTUMN_SDK

config BR2_PACKAGE_AUTUMN_PKG_CNV
	bool "Autumn Package Converter"
	depends on BR2_PACKAGE_PYTHON3
	select BR2_PACKAGE_AUTUMN_PKG_UNPK
	help
	   Tool to convert your binary to AutumnOS suitable archive format (.atm)


config BR2_PACKAGE_AUTUMN_API_DEV
	bool "AutumnOS API"
	help
	   AutumnOS API for hardware status monitoring and low-level communication.

config BR2_PACKAGE_AUTUMN_PKG_UNPK
	bool "Autumn Binary (.atm) Unpackager"
	help
	   An unpackager for AutumnOS archives

config BR2_PACKAGE_ASDK_ENGINE
	bool "AutumnOS SDK G-Engine"
	depends on BR2_PACKAGE_LUA
	help
	   Lua based graphics engine for AutumnOS SDK Environment.
endif
```

## autumnos-mobile-1.0/buildroot/lv_drivers/Config.in
```kconfig
config BR2_PACKAGE_LV_DRIVERS
bool "lv_drivers"
depends on BR2_PACKAGE_LVGL
help
  Drivers for LVGL (Framebuffer, SDL, etc.)
  https://github.com/lvgl/lv_drivers
```

## autumnos-mobile-1.0/buildroot/lvgl/Config.in
```kconfig
config BR2_PACKAGE_LVGL
bool "lvgl"
help
  Light and Versatile Graphics Library.
  https://lvgl.io
```
